## build/Kconfig/boards/Kconfig
```kconfig
# Load Zephyr board Kconfig descriptions.
osource "/home/barth/zephyrproject/zephyr/boards/seeed/xiao_esp32c3/Kconfig"
```

## build/Kconfig/boards/Kconfig.defconfig
```kconfig
# Load Zephyr board defconfig descriptions.
osource "/home/barth/zephyrproject/zephyr/boards/seeed/xiao_esp32c3/Kconfig.defconfig"
```

## build/Kconfig/boards/Kconfig.sysbuild
```kconfig
# Load Sysbuild board Kconfig descriptions.
osource "/home/barth/zephyrproject/zephyr/boards/seeed/xiao_esp32c3/Kconfig.sysbuild"
```

## build/Kconfig/boards/Kconfig.xiao_esp32c3
```kconfig
# Load board Kconfig descriptions.
osource "/home/barth/zephyrproject/zephyr/boards/seeed/xiao_esp32c3/Kconfig.xiao_esp32c3"
```
